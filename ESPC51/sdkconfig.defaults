## ESPC51/sdkconfig.defaults
```kconfig
# C5 terminal 只访问 ESPS3 local gateway；Server-facing TLS/HTTP 上传由 ESPS3 处理。
# CONFIG_WS_TRANSPORT is not set

CONFIG_PARTITION_TABLE_CUSTOM=y
CONFIG_PARTITION_TABLE_CUSTOM_FILENAME="partitions.csv"
CONFIG_PARTITION_TABLE_FILENAME="partitions.csv"
CONFIG_PARTITION_TABLE_OFFSET=0x8000

CONFIG_ESPTOOLPY_FLASHSIZE_16MB=y
CONFIG_ESPTOOLPY_FLASHSIZE="16MB"

CONFIG_SPIRAM=y
CONFIG_SPIRAM_MODE_QUAD=y
CONFIG_SPIRAM_SPEED_40M=y
CONFIG_SPIRAM_SPEED=40
CONFIG_SPIRAM_USE_MALLOC=y
CONFIG_SPIRAM_MEMTEST=y
CONFIG_SPIRAM_MALLOC_ALWAYSINTERNAL=16384
CONFIG_SPIRAM_MALLOC_RESERVE_INTERNAL=32768

CONFIG_SR_WN_WN9S_NIHAOXIAOZHI=y

CONFIG_BT_ENABLED=y
CONFIG_BT_NIMBLE_ENABLED=y
CONFIG_BT_NIMBLE_ROLE_CENTRAL=y
# CONFIG_BT_BLUEDROID_ENABLED is not set

CONFIG_ESP_MAIN_TASK_STACK_SIZE=12288

# Use Method 2 canaries plus the per-core end-of-stack watchpoint to catch C5 task overflows.
CONFIG_FREERTOS_CHECK_STACKOVERFLOW_CANARY=y
CONFIG_FREERTOS_WATCHPOINT_END_OF_STACK=y

# Active WiFi channel-state capture was removed; IDF maps its legacy alias to this symbol.
# CONFIG_ESP_WIFI_CSI_ENABLED is not set
```

## ESPC52/sdkconfig.defaults
```kconfig
# C5 terminal 只访问 ESPS3 local gateway；Server-facing TLS/HTTP 上传由 ESPS3 处理。
# CONFIG_WS_TRANSPORT is not set

CONFIG_PARTITION_TABLE_CUSTOM=y
CONFIG_PARTITION_TABLE_CUSTOM_FILENAME="partitions.csv"
CONFIG_PARTITION_TABLE_FILENAME="partitions.csv"
CONFIG_PARTITION_TABLE_OFFSET=0x8000

CONFIG_ESPTOOLPY_FLASHSIZE_16MB=y
CONFIG_ESPTOOLPY_FLASHSIZE="16MB"

CONFIG_SPIRAM=y
CONFIG_SPIRAM_MODE_QUAD=y
CONFIG_SPIRAM_SPEED_40M=y
CONFIG_SPIRAM_SPEED=40
CONFIG_SPIRAM_USE_MALLOC=y
CONFIG_SPIRAM_MEMTEST=y
CONFIG_SPIRAM_MALLOC_ALWAYSINTERNAL=16384
CONFIG_SPIRAM_MALLOC_RESERVE_INTERNAL=32768
CONFIG_SPIRAM_ALLOW_STACK_EXTERNAL_MEMORY=y
# The UI registers a 92 KiB PSRAM pool. Keep the 2 KiB bootstrap and reserve
# 96 KiB expansion so the LVGL 9 TLSF pool limit covers the pool plus overhead.
CONFIG_LV_MEM_SIZE_KILOBYTES=2
CONFIG_LV_MEM_POOL_EXPAND_SIZE_KILOBYTES=96
CONFIG_LV_USE_SPAN=n

CONFIG_SR_WN_WN9S_NIHAOXIAOZHI=y

CONFIG_BT_ENABLED=y
CONFIG_BT_NIMBLE_ENABLED=y
CONFIG_BT_NIMBLE_ROLE_CENTRAL=y
# CONFIG_BT_BLUEDROID_ENABLED is not set

CONFIG_ESP_MAIN_TASK_STACK_SIZE=12288

# Active WiFi channel-state capture was removed; IDF maps its legacy alias to this symbol.
# CONFIG_ESP_WIFI_CSI_ENABLED is not set
# Keep both the software canary and the hardware stack-end watchpoint enabled.
CONFIG_FREERTOS_CHECK_STACKOVERFLOW_CANARY=y
CONFIG_FREERTOS_WATCHPOINT_END_OF_STACK=y
CONFIG_COMPILER_STACK_CHECK_MODE_ALL=y
CONFIG_FREERTOS_USE_TRACE_FACILITY=y
```

## ESPS3/sdkconfig.defaults
```kconfig
# ESP32-S3 N32R16 local gateway defaults.
CONFIG_S3_LOCAL_LD2450_UART_ENABLED=y
CONFIG_S3_LOCAL_LD2450_UART_PORT=1
CONFIG_S3_LOCAL_LD2450_UART_TX_GPIO=18
CONFIG_S3_LOCAL_LD2450_UART_RX_GPIO=17

CONFIG_PARTITION_TABLE_CUSTOM=y
CONFIG_PARTITION_TABLE_CUSTOM_FILENAME="partitions.csv"
CONFIG_PARTITION_TABLE_FILENAME="partitions.csv"
CONFIG_PARTITION_TABLE_OFFSET=0x8000

CONFIG_ESPTOOLPY_FLASHSIZE_32MB=y
CONFIG_ESPTOOLPY_FLASHSIZE="32MB"

CONFIG_SPIRAM=y
CONFIG_SPIRAM_MODE_OCT=y
CONFIG_SPIRAM_TYPE_AUTO=y
CONFIG_SPIRAM_SPEED_80M=y
CONFIG_SPIRAM_BOOT_INIT=y
CONFIG_SPIRAM_USE_MALLOC=y
CONFIG_SPIRAM_MEMTEST=y
CONFIG_SPIRAM_MALLOC_ALWAYSINTERNAL=16384
CONFIG_SPIRAM_MALLOC_RESERVE_INTERNAL=32768
CONFIG_SPIRAM_TRY_ALLOCATE_WIFI_LWIP=y
CONFIG_FREERTOS_TASK_CREATE_ALLOW_EXT_MEM=y

CONFIG_ESP_MAIN_TASK_STACK_SIZE=8192
# Comprehensive poisoning verifies every free region, including the 16 MiB
# PSRAM heap.  The default 300 ms IWDT window is shorter than that startup scan.
CONFIG_ESP_INT_WDT_TIMEOUT_MS=5000
# FreeRTOS method 2 canaries plus comprehensive heap poisoning are required
# for startup memory-corruption diagnosis.
CONFIG_FREERTOS_CHECK_STACKOVERFLOW_CANARY=y
CONFIG_HEAP_POISONING_COMPREHENSIVE=y
CONFIG_COMPILER_STACK_CHECK_MODE_ALL=y
CONFIG_HTTPD_MAX_REQ_HDR_LEN=1024
CONFIG_HTTPD_MAX_URI_LEN=256
CONFIG_MBEDTLS_SSL_IN_CONTENT_LEN=16384
CONFIG_MBEDTLS_SSL_OUT_CONTENT_LEN=16384
# CONFIG_WS_TRANSPORT is not set
# SPI flash auto-suspend is disabled; forcing generic system code into the
# constrained bootloader IRAM gives no cache-off benefit and overflows it.
# CONFIG_ESP_SYSTEM_IN_IRAM is not set
```

## 分支项目/ESP 雷达/ESPS3/components/radar_ld2450/Kconfig
```kconfig
menu "S3 local LD2450 radar"

config S3_LOCAL_LD2450_UART_ENABLED
    bool "Enable the wired S3 local LD2450 UART"
    default n
    help
        Enable only after the actual LD2450 wiring has been confirmed. The
        runtime still rejects invalid port or GPIO values instead of guessing.

config S3_LOCAL_LD2450_UART_PORT
    int "UART controller"
    default 1
    help
        UART controller reserved for the S3-local LD2450. UART0 is the console
        and must not be selected for this radar.

config S3_LOCAL_LD2450_UART_TX_GPIO
    int "MCU TX GPIO to LD2450 RX"
    default -1
    help
        Enter the confirmed MCU TX GPIO. Leave at -1 until wired.

config S3_LOCAL_LD2450_UART_RX_GPIO
    int "MCU RX GPIO from LD2450 TX"
    default -1
    help
        Enter the confirmed MCU RX GPIO. Leave at -1 until wired.

config RADAR_RAW_DEBUG
    bool "Enable bounded LD2450 raw-frame debug"
    default n
    help
        Emit at most one bounded raw UART hex dump per second. Keep disabled
        during normal operation because it is a diagnostic-only serial cost.

endmenu
```

## 分支项目/ESP/ESPS3/sdkconfig.defaults
```kconfig
# ESP32-S3 N32R16 local gateway defaults.

CONFIG_PARTITION_TABLE_CUSTOM=y
CONFIG_PARTITION_TABLE_CUSTOM_FILENAME="partitions.csv"
CONFIG_PARTITION_TABLE_FILENAME="partitions.csv"
CONFIG_PARTITION_TABLE_OFFSET=0x8000

CONFIG_ESPTOOLPY_FLASHSIZE_32MB=y
CONFIG_ESPTOOLPY_FLASHSIZE="32MB"

CONFIG_SPIRAM=y
CONFIG_SPIRAM_MODE_OCT=y
CONFIG_SPIRAM_TYPE_AUTO=y
CONFIG_SPIRAM_SPEED_80M=y
CONFIG_SPIRAM_BOOT_INIT=y
CONFIG_SPIRAM_USE_MALLOC=y
CONFIG_SPIRAM_MEMTEST=y
CONFIG_SPIRAM_MALLOC_ALWAYSINTERNAL=16384
CONFIG_SPIRAM_MALLOC_RESERVE_INTERNAL=32768

CONFIG_ESP_MAIN_TASK_STACK_SIZE=8192
CONFIG_HTTPD_MAX_REQ_HDR_LEN=1024
CONFIG_HTTPD_MAX_URI_LEN=256
CONFIG_MBEDTLS_SSL_IN_CONTENT_LEN=16384
CONFIG_MBEDTLS_SSL_OUT_CONTENT_LEN=16384
# CONFIG_WS_TRANSPORT is not set
```
